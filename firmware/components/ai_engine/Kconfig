## firmware/components/ai_engine/Kconfig
```kconfig
menu "AI engine"

    choice AI_RUNTIME
        prompt "Inference runtime"
        default AI_RUNTIME_TFLM
        help
            Which runtime this image builds and links; the other one's code
            stays in the tree for the comparison of KEHOACH 3 layer 5. The
            models partition must carry files of the same runtime.

        config AI_RUNTIME_TFLM
            bool "TFLite Micro with esp-nn"

        config AI_RUNTIME_ESPDL
            bool "ESP-DL"
    endchoice

    config AI_WEIGHTS_PSRAM_DETECT
        bool "Copy the detection weights into PSRAM"
        depends on AI_RUNTIME_ESPDL && SPIRAM
        default y
        help
            ESP-DL copies the parameters out of the flash mapping when it
            builds the graph (param_copy), and reads them over octal PSRAM
            instead of quad flash. Measured faster on every model tried
            (KEHOACH 3 layer 5); n reads them in place and spends no PSRAM.

    config AI_WEIGHTS_PSRAM_SPOOF
        bool "Copy the anti-spoof weights into PSRAM"
        depends on AI_RUNTIME_ESPDL && SPIRAM
        default y
        help
            As for detection.

    config AI_WEIGHTS_PSRAM_RECOG
        bool "Copy the recognition weights into PSRAM"
        depends on AI_RUNTIME_ESPDL && SPIRAM
        default y
        help
            As for detection.

    config AI_ARENA_FAST_KB
        int "Ceiling for the detection arena (KB)"
        depends on AI_RUNTIME_TFLM
        default 224
        range 16 2048
        help
            Detection is the only branch that runs on every frame, so it gets
            an arena to itself (KEHOACH 3.8). The size comes from the image:
            models_0 carries arena_hint per entry, and this only caps it, so a
            model of another size needs no rebuild. Used when the image says 0.

    config AI_ARENA_FAST_INTERNAL
        bool "Ask for the detection arena in internal SRAM"
        depends on AI_RUNTIME_TFLM
        default n
        help
            Internal SRAM buys detection 23.3 ms per frame, but the 224 KB it
            costs leaves the LCD bounce buffer and the Wi-Fi stack short by
            156 KB (KEHOACH 6.4). Turn this on once the models shrink enough
            for that budget to close. The arena falls back to PSRAM, loudly,
            when it does not fit.

    config AI_ARENA_BIG_KB
        int "Ceiling for the anti-spoof and recognition arena, PSRAM (KB)"
        depends on AI_RUNTIME_TFLM
        default 1536
        range 64 8192
        help
            Both run only once a face appears, rarely enough for PSRAM, and
            they share one MicroAllocator so their heads overlap while their
            tails stack (KEHOACH 3.8). Each of the two entries carries the pair
            total in arena_hint and the engine takes the max; this only caps it.

    config AI_PROFILING
        bool "Report ticks per operator after every invoke"
        default n
        help
            TFLM: turns on the MicroProfiler, which costs roughly 48 KB of
            static RAM and a print per invoke; E8-T8 uses it to tell an operator
            with an ESP-NN kernel from one running the reference C path.
            ESP-DL: every invoke runs through profile_module and prints the
            latency of each module, sorted.

endmenu
```

## firmware/components/bsp_board/Kconfig
```kconfig
menu "Board support"

    config BSP_BRINGUP_CHECKS
        bool "Report I2C pin state and scan the bus"
        default y
        help
            Logs whether each I2C line has an external pull-up, and offers
            bsp_i2c_scan(). Bring-up only: the pin report reconfigures SDA and
            SCL as plain GPIO on the way into bsp_board_init.

endmenu
```

## firmware/components/bsp_board/test_apps/buses/sdkconfig.defaults
```kconfig
CONFIG_IDF_TARGET="esp32s3"
CONFIG_ESP_CONSOLE_USB_SERIAL_JTAG=y
CONFIG_UNITY_ENABLE_IDF_TEST_RUNNER=y
```

## firmware/components/drv_camera/Kconfig
```kconfig
menu "Camera driver"

    config DRV_CAMERA_SELFTEST
        bool "Offer drv_camera_selftest()"
        default y
        help
            Grabs twenty frames and logs their geometry and rate.
            Bring-up only: it blocks the boot for about a second.

endmenu
```

## firmware/components/drv_camera/test_apps/sensor/sdkconfig.defaults
```kconfig
CONFIG_IDF_TARGET="esp32s3"
CONFIG_ESP_CONSOLE_USB_SERIAL_JTAG=y
CONFIG_UNITY_ENABLE_IDF_TEST_RUNNER=y
CONFIG_SPIRAM=y
CONFIG_SPIRAM_MODE_OCT=y
CONFIG_SPIRAM_SPEED_80M=y
CONFIG_SPIRAM_USE_MALLOC=y
CONFIG_COMPILER_STACK_CHECK_MODE_STRONG=y
```

## firmware/components/drv_lcd/Kconfig
```kconfig
menu "LCD driver"

    config DRV_LCD_SELFTEST
        bool "Offer drv_lcd_selftest()"
        default y
        help
            Walks the panel through four colours, holding each for 700 ms.
            Bring-up only: it costs about three seconds of every boot.

endmenu
```

## firmware/components/drv_lcd/test_apps/panel/sdkconfig.defaults
```kconfig
CONFIG_IDF_TARGET="esp32s3"
CONFIG_ESP_CONSOLE_USB_SERIAL_JTAG=y
CONFIG_UNITY_ENABLE_IDF_TEST_RUNNER=y
CONFIG_COMPILER_STACK_CHECK_MODE_STRONG=y
```

## firmware/components/drv_touch/Kconfig
```kconfig
menu "Touch driver"

    config DRV_TOUCH_SELFTEST
        bool "Offer drv_touch_selftest()"
        default y
        help
            Polls the controller for a few seconds and logs each contact.
            Bring-up only: it blocks the boot for as long as it watches.

endmenu
```

## firmware/components/net_mqtt/Kconfig
```kconfig
menu "MQTT link"

    config NET_MQTT_DEFAULT_URI
        string "Broker URI when NVS holds none"
        default "mqtts://mqtt.cckiosk.io.vn:8883"
        help
            Fallback for device/mqtt_uri (KEHOACH 6.2.1). A shipped build
            carries the vendor's own broker here so a unit needs nobody to
            type an address; NVS overrides it for a customer who self-hosts
            and for a bench broker.

    config NET_MQTT_REQUIRE_TLS
        bool "Refuse a broker URI that is not mqtts://"
        default n
        help
            On in sdkconfig.prod. A plaintext URI on a shipped kiosk would
            put attendance records on the wire in the clear, and one wrong
            digit in a port is all it takes (KEHOACH 6.2.1).

    config NET_MQTT_KEEPALIVE_S
        int "Seconds between keepalive pings"
        default 60
        range 10 600
        help
            The broker declares the kiosk dead and fires its will after
            roughly 1.5 times this.

endmenu
```

## firmware/components/net_provision/Kconfig
```kconfig
menu "Kiosk registration"

    config NET_PROVISION_API_URL
        string "API the kiosk asks for its ticket"
        default "https://api.cckiosk.io.vn"
        help
            Base of POST /devices/register and GET /devices/me (KEHOACH 7.3).
            Its certificate chains to a public root, so the IDF bundle is
            what trusts it, not the broker's own CA.

    config NET_PROVISION_BOOTSTRAP_TOKEN
        string "Batch token the kiosk registers with"
        default ""
        help
            The DEVICE_BOOTSTRAP_TOKEN of api (KEHOACH 7.3). Never set here:
            it arrives from firmware/sdkconfig.secrets, which git ignores.
            Empty means this build never registers.

    config NET_PROVISION_WAIT_MIN_S
        int "First wait between asks, in seconds"
        default 10
        range 5 600

    config NET_PROVISION_WAIT_MAX_S
        int "Longest wait between asks, in seconds"
        default 300
        range 30 3600

    config NET_PROVISION_POLL_FLOOR_S
        int "Fastest pace a pending kiosk accepts from the server, in seconds"
        default 2
        range 1 60
        help
            The 202 names how often to ask (KEHOACH 7.3); a server that
            says 0 is held to this rather than asked in a tight loop.

    config NET_PROVISION_RENEW_BEFORE_DAYS
        int "Days before the ticket's exp at which the kiosk renews it"
        default 7
        range 1 30
        help
            Must stay well under DEVICE_TOKEN_TTL_DAYS of api, or a fresh
            ticket is due again the moment it lands (KEHOACH 7.3).

endmenu
```

## firmware/components/svc_attendance/Kconfig
```kconfig
menu "Attendance"

    config ATTEND_SEED_DEDUP_MIN
        int "Seed for the window that swallows a second stamp (minutes)"
        default 5
        range 1 720
        help
            Written to NVS key attend/dedup_min on the first boot only
            (KEHOACH 6.2.1); afterwards the kiosk reads NVS and SET_CONFIG
            changes it. A second scan inside the window still opens the
            door, it just writes no record (KEHOACH 4.5.5f).

    config ATTEND_SEED_ALLOW_NO_SPOOF
        bool "Seed for granting on a negative liveness score"
        default n
        help
            Written to NVS key attend/allow_no_spoof on the first boot only.
            A kiosk that cannot tell a face from a photo should not open a
            door, so this is for a bench running an image with no spoof
            branch (KEHOACH 4.5.5f).

endmenu
```

## firmware/components/svc_facedb/Kconfig
```kconfig
menu "Face database"

    config FACEDB_MAX_RECORDS
        int "Templates the table holds in PSRAM"
        default 1000
        range 2 4000
        help
            One record is 576 bytes (KEHOACH 6.2.4), so the default of 1000
            records, about 333 people at three templates a capture, reserves
            576 KB of PSRAM once at init. A table that fills up compacts its
            soft-deleted records first and refuses the enrol only when that
            frees nothing.

endmenu
```

## firmware/components/svc_facedb/test_apps/facedb/sdkconfig.defaults
```kconfig
CONFIG_IDF_TARGET="esp32s3"
CONFIG_ESP_CONSOLE_USB_SERIAL_JTAG=y
CONFIG_UNITY_ENABLE_IDF_TEST_RUNNER=y
CONFIG_PARTITION_TABLE_CUSTOM=y
CONFIG_PARTITION_TABLE_CUSTOM_FILENAME="partitions.dev.csv"
CONFIG_ESPTOOLPY_FLASHSIZE_16MB=y
CONFIG_ESPTOOLPY_FLASHMODE_QIO=y
CONFIG_ESPTOOLPY_FLASHFREQ_80M=y
CONFIG_COMPILER_STACK_CHECK_MODE_STRONG=y
CONFIG_COMPILER_OPTIMIZATION_PERF=y
```

## firmware/components/svc_sync/Kconfig
```kconfig
menu "Attendance uplink"

    config SYNC_BATCH_RECORDS
        int "Records one drain sends before it hands the task back"
        default 16
        range 1 256
        help
            A drain holds m_littlefs for its whole run, so a boundless batch
            would block attend_task for as long as the backlog is deep. One
            batch of 16 at QoS 1 is well under a second on a healthy link,
            and a caller that sees ESP_ERR_NOT_FINISHED simply calls again.

    config SYNC_ACK_TIMEOUT_MS
        int "How long a record waits for the broker's puback"
        default 5000
        range 500 30000
        help
            Longer than a keepalive round trip on a slow link, short enough
            that a dead broker does not hold the batch for a minute. The
            cursor does not move until this ack arrives (KEHOACH 6.2.6).

endmenu
```

## firmware/components/svc_vision/Kconfig
```kconfig
menu "Vision pipeline"

    config VISION_SEED_FACE_MIN_PX
        int "Seed for the smallest face the pipeline verifies (frame pixels)"
        default 100
        range 16 480
        help
            Written to NVS key vision/face_min_px on the first boot, and again
            only when a firmware raises the seed set (KEHOACH 6.2.1).
            Recognition warps the face onto its input square, 112x112 on the
            deployed model. Someone standing at the distance the guide frame
            invites measures 107-110 px, so a gate at the input side would be
            one nobody clears from there (KEHOACH 4.5.5d).

    config VISION_SEED_GUIDE_MIN_PERCENT
        int "Seed for the share of a face that must sit inside the guide (percent)"
        default 50
        range 1 100
        help
            Written to NVS key vision/guide_min as the face_min_px seed is. Half
            the face box inside the drawn guide lets someone standing a head
            off centre check in, and a face that is not on the glass is never
            judged, since the guide lies inside the preview slice (KEHOACH 4.5.5d).

    config VISION_SEED_PRESENT_MM
        int "Seed for the distance that counts as someone standing there (mm)"
        default 700
        range 40 1300
        help
            Written to NVS key vision/present_mm as the face_min_px seed is.
            Recognition works between 250 and 420 mm (KEHOACH 3), so the
            gate sits past that: someone inside this distance wakes the
            pipeline, which then asks them to come closer (KEHOACH 2.3D).

endmenu
```

## firmware/components/sys_time/Kconfig
```kconfig
menu "sys_time"

    config SYS_TIME_TZ
        string "POSIX time zone the screen reads the clock in"
        default "ICT-7"
        help
            Registers and records stay in UTC; this only moves what a person
            sees. NVS device/tz overrides it from the first boot that has one.
            POSIX signs are inverted: ICT-7 is UTC+7.

endmenu
```

## firmware/components/ui_kiosk/Kconfig
```kconfig
menu "Kiosk screen"

    config UI_ENROL_NAME
        string "Name the board button enrols under"
        default "Nhân viên 1"
        help
            The board button is the fallback path for adding a face, and NVS key
            device/enrol_name overrides this at run time.

    config UI_MIN_BRIGHTNESS
        int "Lowest backlight percent the slider or a stored value can set"
        range 1 50
        default 10
        help
            A dark panel cannot be read to turn it back up, so neither the
            settings slider nor ui/brightness from NVS goes below this.

    config UI_SEED_BRIGHTNESS
        int "Backlight percent a kiosk starts life at"
        range UI_MIN_BRIGHTNESS 100
        default 100
        help
            Seeds NVS ui/brightness on first boot, the way svc_vision seeds its
            thresholds. The settings slider owns the key after that (KEHOACH 6.2.1).

    config UI_SEED_VOLUME
        int "Speaker percent a kiosk starts life at"
        range 0 100
        default 70
        help
            Seeds NVS ui/volume on first boot. Only the door chime uses it, so a
            quiet office can take it to zero without losing a refusal message.

endmenu
```

## firmware/main/Kconfig.projbuild
```kconfig
menu "Kiosk application"

    config APP_CONSOLE
        bool "Provisioning console on the USB port"
        default n
        help
            Serves nvs get and nvs set over USB so wifi and broker settings
            reach NVS without any file holding a secret (KEHOACH 6.2.1).
            Off here and on in sdkconfig.dev and sdkconfig.bench: a prod image
            compiles none of it, because a runtime flag would live in the very
            NVS the console can write and could re-enable itself.

    config APP_SNTP_DEFAULT_HOST
        string "SNTP host when NVS holds none"
        default "pool.ntp.org"
        help
            Fallback for device/sntp_host (KEHOACH 6.2.1). Without one a prod
            image, which has no console, never corrects its clock.

endmenu
```

## firmware/test_apps/bench_ai/sdkconfig.defaults
```kconfig
CONFIG_IDF_TARGET="esp32s3"
CONFIG_ESP_CONSOLE_USB_SERIAL_JTAG=y
CONFIG_UNITY_ENABLE_IDF_TEST_RUNNER=y
CONFIG_PARTITION_TABLE_CUSTOM=y
CONFIG_PARTITION_TABLE_CUSTOM_FILENAME="partitions.dev.csv"
CONFIG_ESPTOOLPY_FLASHSIZE_16MB=y
CONFIG_COMPILER_OPTIMIZATION_PERF=y
CONFIG_COMPILER_OPTIMIZATION_ASSERTIONS_SILENT=y
CONFIG_HEAP_POISONING_DISABLED=y
CONFIG_ESP_TASK_WDT_EN=n
CONFIG_AI_ARENA_FAST_KB=224
CONFIG_AI_ARENA_BIG_KB=1536
```
